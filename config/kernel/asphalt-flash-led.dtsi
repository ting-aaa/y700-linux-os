// SPDX-License-Identifier: GPL-2.0-only
/*
 * Rear LED flash/torch wiring for Lenovo Legion Y700 Gen 2 (TB320FC_PRC).
 * Stock CN350 DT pairs PM8350C flash channels qcom,id 1 and 2 (1-based <2>, <3>)
 * with 500 mA/ch torch and 1500 mA/ch flash declarations (1280 ms max timeout).
 * Conservative operating limits are applied here: 300 mA total torch, 1000 mA total flash.
 */
#include <dt-bindings/leds/common.h>

&pm8350c_flash {
	status = "okay";

	rear_flash_led: led-0 {
		function = LED_FUNCTION_FLASH;
		color = <LED_COLOR_ID_WHITE>;
		led-sources = <2>, <3>;
		led-max-microamp = <300000>;
		flash-max-microamp = <1000000>;
		flash-max-timeout-us = <1280000>;
	};
};
